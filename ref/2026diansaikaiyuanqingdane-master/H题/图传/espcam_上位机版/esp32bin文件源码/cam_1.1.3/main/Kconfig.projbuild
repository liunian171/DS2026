## ref/2026diansaikaiyuanqingdane-master/H题/图传/espcam_上位机版/esp32bin文件源码/cam_1.1.3/main/Kconfig.projbuild
```kconfig
menu "Camera Upload Configuration"

config CAMERA_WIFI_SSID
    string "Wi-Fi SSID"
    default "yyq"

config CAMERA_WIFI_PASSWORD
    string "Wi-Fi Password"
    default "12345678"

config CAMERA_UPLOAD_URL
    string "HTTP Upload URL"
    default "http://10.104.1.173:8000/upload"

config CAMERA_UPLOAD_INTERVAL_MS
    int "Upload Interval (ms)"
    range 500 60000
    default 1000

endmenu
```
